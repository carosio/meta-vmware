## conf/layer.conf
```bitbake
# We have a conf and classes directory, add to BBPATH
BBPATH := "${BBPATH}:${LAYERDIR}"

# We have a recipes directory, add to BBFILES
BBFILES := "${BBFILES} ${LAYERDIR}/recipes-*/*/*.bb \
        ${LAYERDIR}/recipes-*/*/*.bbappend"

BBFILE_COLLECTIONS += "vmware"
BBFILE_PATTERN_vmware := "^${LAYERDIR}/"
BBFILE_PRIORITY_vmware = "15"

OVFFILES = "${LAYERDIR}/files"
```

## conf/machine/virtualbox.conf
```bitbake
#@TYPE: Machine
#@NAME: virtualbox

#@DESCRIPTION: Machine configuration for virtualbox

PREFERRED_PROVIDER_virtual/kernel ?= "linux-caros"
PREFERRED_VERSION_linux-yocto ?= "3.8%"

DEFAULTTUNE ?= "core2-64"
require conf/machine/include/tune-core2.inc

KERNEL_IMAGETYPE = "bzImage"
IMAGE_FSTYPES = "ova"

MACHINE_ESSENTIAL_EXTRA_RDEPENDS_append = " udev-vmware vboxguestdrivers e2fsprogs-mke2fs"

FEEDNAMEPREFIX ?= "caros-virtualbox"
FEEDURIPREFIX ?= "virtualbox"

IMAGE_CLASSES += "image-ova"

# Number of CPU cores
CORE_NUMBER ?= "2"

# RAM Size in  Mbyte
RAM_SIZE ?= "8192"

# Root-FS size in Kbyte
IMAGE_ROOTFS_SIZE ?= "8286208"
IMAGE_OVERHEAD_FACTOR = "1.0"

# Data /srv/data disk size in GB
DISK_SIZE_DATA ?= "120"
```

## conf/machine/vmware.conf
```bitbake
#@TYPE: Machine
#@NAME: vmware

#@DESCRIPTION: Machine configuration for vmware

PREFERRED_PROVIDER_virtual/kernel ?= "linux-tplino"
PREFERRED_VERSION_linux-yocto ?= "3.8%"

DEFAULTTUNE ?= "core2-64"
require conf/machine/include/tune-core2.inc

KERNEL_IMAGETYPE = "bzImage"
IMAGE_FSTYPES = "cpio.gz live ova"

MACHINE_ESSENTIAL_EXTRA_RDEPENDS_append = " udev-vmware open-vmware-tools"
MACHINE_FEATURES += "pcbios"

FEEDNAMEPREFIX ?= "tplino-vmware"
FEEDURIPREFIX ?= "vmware"

SYSLINUX_LABELS ?= "install boot"

IMAGE_CLASSES += "image-ova"

# Number of CPU cores
CORE_NUMBER ?= "2"

# RAM Size in  Mbyte
RAM_SIZE ?= "8192"

# Data /srv/data disk size in GB
DISK_SIZE_BOOT ?= "8"
DISK_SIZE_DATA ?= "120"
```
